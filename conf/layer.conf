## conf/layer.conf
```bitbake
# We have a conf and classes directory, add to BBPATH
BBPATH .= ":${LAYERDIR}"

# We have recipes-* directories, add to BBFILES
BBFILES += "${LAYERDIR}/recipes-*/*/*.bb \
            ${LAYERDIR}/recipes-*/*/*.bbappend"

BBFILE_COLLECTIONS += "meta-rayman"
BBFILE_PATTERN_meta-rayman = "^${LAYERDIR}/"
BBFILE_PRIORITY_meta-rayman = "6"

LAYERDEPENDS_meta-rayman = "core"
LAYERSERIES_COMPAT_meta-rayman = "warrior zeus"

# Configure the distro
DISTRO_FEATURES_append = " systemd"
VIRTUAL-RUNTIME_init_manager = "systemd"
DISTRO_FEATURES_BACKFILL_CONSIDERED = "sysvinit"
```
